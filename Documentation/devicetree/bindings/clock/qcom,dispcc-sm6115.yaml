## Documentation/devicetree/bindings/clock/qcom,dispcc-sm6115.yaml
```yaml
# SPDX-License-Identifier: (GPL-2.0-only OR BSD-2-Clause)
%YAML 1.2
---
$id: http://devicetree.org/schemas/clock/qcom,dispcc-sm6115.yaml#
$schema: http://devicetree.org/meta-schemas/core.yaml#

title: Qualcomm Display Clock Controller Binding for SM6115

maintainers:
  - Taniya Das <tdas@codeaurora.org>

description: |
  Qualcomm display clock control module which supports the clocks and
  power domains on SM6115.

  See also:
    dt-bindings/clock/qcom,dispcc-sm6115.h

properties:
  compatible:
    enum:
      - qcom,sm6115-dispcc

  clocks:
    items:
      - description: Board XO source
      - description: Byte clock from DSI PHY0
      - description: Pixel clock from DSI PHY0
      - description: Pixel clock from DSI PHY1
      - description: GPLL0 clock from GCC
      - description: GPLL0 DIV clock from GCC
      - description: Board sleep clock

  clock-names:
    items:
      - const: bi_tcxo
      - const: dsi0_phy_pll_out_byteclk
      - const: dsi0_phy_pll_out_dsiclk
      - const: dsi1_phy_pll_out_dsiclk
      - const: gcc_disp_gpll0_clk_src
      - const: gcc_disp_gpll0_div_clk_src
      - const: sleep_clk

  '#clock-cells':
    const: 1

  '#power-domain-cells':
    const: 1

  reg:
    maxItems: 1

required:
  - compatible
  - reg
  - clocks
  - clock-names
  - '#clock-cells'
  - '#power-domain-cells'

additionalProperties: false

examples:
  - |
    #include <dt-bindings/clock/qcom,rpmcc.h>
    #include <dt-bindings/clock/qcom,gcc-sm6115.h>
    clock-controller@5f00000 {
      compatible = "qcom,sm6115-dispcc";
      reg = <0x5f00000 0x20000>;
      clocks = <&rpmcc RPM_SMD_XO_CLK_SRC>,
               <&dsi0_phy 0>,
               <&dsi0_phy 1>,
               <&dsi1_phy 1>,
               <&gcc GCC_DISP_GPLL0_CLK_SRC>,
               <&gcc GCC_DISP_GPLL0_DIV_CLK_SRC>,
               <&sleep_clk>;
      clock-names = "bi_tcxo",
                    "dsi0_phy_pll_out_byteclk",
                    "dsi0_phy_pll_out_dsiclk",
                    "dsi1_phy_pll_out_dsiclk",
                    "gcc_disp_gpll0_clk_src",
                    "gcc_disp_gpll0_div_clk_src",
                    "sleep_clk";
      #clock-cells = <1>;
      #power-domain-cells = <1>;
    };
...
```

## Documentation/devicetree/bindings/clock/qcom,gcc-msm8976.yaml
```yaml
# SPDX-License-Identifier: GPL-2.0-only
%YAML 1.2
---
$id: <a  rel="nofollow" href="http://devicetree.org/schemas/clock/qcom,gcc-msm8976.yaml#">http://devicetree.org/schemas/clock/qcom,gcc-msm8976.yaml#</a>
$schema: <a  rel="nofollow" href="http://devicetree.org/meta-schemas/core.yaml#">http://devicetree.org/meta-schemas/core.yaml#</a>

title: Qualcomm Global Clock & Reset Controller Binding for MSM8976

maintainers:
  - Stephen Boyd <sboyd@xxxxxxxxxx>
  - Taniya Das <tdas@xxxxxxxxxxxxxx>

description: |
  Qualcomm global clock control module which supports the clocks, resets and
  power domains on MSM8976.

  See also:
  - dt-bindings/clock/qcom,gcc-msm8976.h

properties:
  compatible:
    enum:
      - qcom,gcc-msm8976
      - qcom,gcc-msm8976-v1.1

  clocks:
    items:
      - description: XO source
      - description: Always-on XO source
      - description: Pixel clock from DSI PHY0
      - description: Byte clock from DSI PHY0
      - description: Pixel clock from DSI PHY1
      - description: Byte clock from DSI PHY1

  clock-names:
    items:
      - const: xo
      - const: xo_a
      - const: dsi0pll
      - const: dsi0pllbyte
      - const: dsi1pll
      - const: dsi1pllbyte

  '#clock-cells':
    const: 1

  '#reset-cells':
    const: 1

  '#power-domain-cells':
    const: 1

  reg:
    maxItems: 1

required:
  - compatible
  - reg
  - clocks
  - clock-names
  - '#clock-cells'
  - '#reset-cells'
  - '#power-domain-cells'

additionalProperties: false

examples:
  - |
    clock-controller@1800000 {
      compatible = "qcom,gcc-msm8976";
      #clock-cells = <1>;
      #reset-cells = <1>;
      #power-domain-cells = <1>;
      reg = <0x1800000 0x80000>;

      clocks = <&xo_board>,
               <&xo_board>,
               <&dsi0_phy 1>,
               <&dsi0_phy 0>,
               <&dsi1_phy 1>,
               <&dsi1_phy 0>;

      clock-names = "xo",
                    "xo_a",
                    "dsi0pll",
                    "dsi0pllbyte",
                    "dsi1pll",
                    "dsi1pllbyte";
    };
...
```

## Documentation/devicetree/bindings/display/msm/dpu-sm6115.yaml
```yaml
# SPDX-License-Identifier: GPL-2.0-only or BSD-2-Clause
%YAML 1.2
---
$id: http://devicetree.org/schemas/display/msm/dpu-sm6115.yaml#
$schema: http://devicetree.org/meta-schemas/core.yaml#

title: Qualcomm Display DPU dt properties for SM6115 target

maintainers:
 

description: |
  Device tree bindings for MSM Mobile Display Subsystem(MDSS) that encapsulates
  sub-blocks like DPU display controller and DSI. Device tree bindings of MDSS
  and DPU are mentioned for SM6115 target.

properties:
  compatible:
    items:
      - const: qcom,sm6115-dpu

  reg:
    items:
      - description: Address offset and size for mdp register set
      - description: Address offset and size for vbif register set

  reg-names:
    items:
      - const: mdp
      - const: vbif

  power-domains:
    maxItems: 1

  clocks:
    items:
      - description: Display AXI clock from gcc
      - description: Display AHB clock from dispcc
      - description: Display core clock from dispcc
      - description: Display lut clock from dispcc
      - description: Display vsync clock from dispcc
      
  clock-names:
    items:
      - const: bus
      - const: iface
      - const: core
      - const: lut
      - const: vsync

  interrupts:
    maxItems: 1

  power-domains:
    maxItems: 1

  operating-points-v2: true
  
      ports:
        $ref: /schemas/graph.yaml#/properties/ports
        description: |
          Contains the list of output ports from DPU device. These ports
          connect to interfaces that are external to the DPU hardware,
          such as DSI. Each output port contains an endpoint that
          describes how it is connected to an external interface.

        properties:
          port@0:
            $ref: /schemas/graph.yaml#/properties/port
            description: DPU_INTF1 (DSI1)

        required:
          - port@0

  required:
  - compatible
  - reg
  - reg-names
  - clocks
  - interrupts
  - power-domains
  - operating-points-v2
  - ports

additionalProperties: false

examples:
  - |
    #include <dt-bindings/clock/qcom,dispcc-sm6115.h>
    #include <dt-bindings/clock/qcom,gcc-sm6115.h>
    #include <dt-bindings/interrupt-controller/arm-gic.h>
    #include <dt-bindings/interconnect/qcom,sm6115.h>
    #include <dt-bindings/power/qcom-rpmpd.h>

    mdss: mdss@5e00000 {
        #address-cells = <1>;
        #size-cells = <1>;
        compatible = "qcom,sm6115-mdss";
        reg = <0x05e00000 0x1000>;
        reg-names = "mdss";
        power-domains = <&dispcc MDSS_GDSC>;
        clocks = <&gcc GCC_DISP_AHB_CLK>,
                 <&gcc GCC_DISP_HF_AXI_CLK>,
                 <&dispcc DISP_CC_MDSS_MDP_CLK>;
        clock-names = "iface", "bus", "core";

        interrupts = <GIC_SPI 186 IRQ_TYPE_LEVEL_HIGH>;
        interrupt-controller;
        #interrupt-cells = <1>;

        interconnects = <&mmrt_virt MASTER_MDP0 &bimc SLAVE_EBI1>;
        interconnect-names = "mdp0-mem";

        iommus = <&apps_smmu 0x420 0x2>,
                 <&apps_smmu 0x421 0x0>;
        ranges;

        mdss_mdp: display-controller@5e01000 {
                compatible = "qcom,sm6115-dpu";
                reg = <0x05e01000 0x8f000>,
                      <0x05eb0000 0x2008>;
                reg-names = "mdp", "vbif";

                clocks = <&gcc GCC_DISP_HF_AXI_CLK>,
                         <&dispcc DISP_CC_MDSS_AHB_CLK>,
                         <&dispcc DISP_CC_MDSS_MDP_CLK>,
                         <&dispcc DISP_CC_MDSS_MDP_LUT_CLK>,
                         <&dispcc DISP_CC_MDSS_VSYNC_CLK>;
                clock-names = "bus", "iface", "core", "lut", "vsync";

                operating-points-v2 = <&mdp_opp_table>;
                power-domains = <&rpmpd SM6115_VDDCX>;

                interrupt-parent = <&mdss>;
                interrupts = <0>;

                ports {
                        #address-cells = <1>;
                        #size-cells = <0>;

                        port@0 {
                                reg = <0>;
                                dpu_intf1_out: endpoint {
                                        remote-endpoint = <&dsi0_in>;
                                };
                        };
                };
         };
    };
...
```

## drivers/input/touchscreen/nt36xxx/Kconfig
```kconfig
# SPDX-License-Identifier: GPL-2.0-only
#
# Novatek NT36XXX touchscreen driver configuration
#
config TOUCHSCREEN_NT36XXX_I2C
	tristate "Novatek NT36XXX over I2C"
	help
	  Say Y here if you have a Novatek NT36XXX over I2C touchscreen connected
	  to your system.
	  Say M, compile into a module.

	  If unsure, say N.

config TOUCHSCREEN_NT36XXX_SPI
	tristate "Novatek NT36XXX over SPI"
	help
	  Say Y here if you have a Novatek NT36XXX over SPI touchscreen connected
	  to your system.
	  Say M, compile into a module.

	  If unsure, say N.
```
